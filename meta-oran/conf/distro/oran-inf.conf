## meta-oran/conf/distro/oran-inf.conf
```bitbake
#
# Copyright (C) 2019 Wind River Systems, Inc.
#
#  Licensed under the Apache License, Version 2.0 (the "License");
#  you may not use this file except in compliance with the License.
#  You may obtain a copy of the License at
#
#      http://www.apache.org/licenses/LICENSE-2.0
#
#  Unless required by applicable law or agreed to in writing, software
#  distributed under the License is distributed on an "AS IS" BASIS,
#  WITHOUT WARRANTIES OR CONDITIONS OF ANY KIND, either express or implied.
#  See the License for the specific language governing permissions and
#  limitations under the License.

#@TYPE: Distro
#@NAME: O-RAN INF
#@DESCRIPTION: O-RAN INF Distribution

PREFERRED_PROVIDER_virtual/kernel = "linux-yocto-rt"
PREFERRED_VERSION_linux-yocto-rt = "4.18%"

require conf/distro/wrlinux.conf
require conf/distro/include/oran-whitelist.conf

# Note that layer.conf will only add items to BBFILES for
# the wrlinux-oran distro (this one).
#
DISTRO_NAME = "O-RAN-INF"

# Set software versions
PREFERRED_VERSION_dpdk ?= "17%"
PREFERRED_VERSION_kubernetes ?= "1.15.2%"
GOVERSION ?= "1.12%"

# Set preferred providers
PREFERRED_PROVIDER_virtual/monitoring ?= "${@bb.utils.contains('MONITORING_FEATURES', 'zabbix', 'packagegroup-zabbix-monitoring',\
    bb.utils.contains('MONITORING_FEATURES', 'nagios', 'packagegroup-nagios-monitoring', 'packagegroup-empty-monitoring', d),d)}"

PREFERRED_PROVIDER_virtual/libibverbs ?= "libibverbs"

# By default including meta-oran layer will build Nagios core
MONITORING_FEATURES ?= "nagios core"

DISTRO_FEATURES_append = " virtualization kvm"
NON_MULTILIB_RECIPES_append = " ceph"

# For images
IMAGE_OVERHEAD_FACTOR ="1.1"
IMAGE_FSTYPES += "tar.bz2 wic.qcow2"

# Use the default splash
SYSLINUX_SPLASH = ""
```

## meta-oran/conf/distro/oran.conf
```bitbake
#@TYPE: Distro
#@NAME: O-RAN
#@DESCRIPTION: O-RAN Distribution

PREFERRED_PROVIDER_virtual/kernel = "linux-yocto-rt"
PREFERRED_VERSION_linux-yocto-rt = "4.18%"

require conf/distro/wrlinux.conf

# Note that layer.conf will only add items to BBFILES for
# the oran distro (this one).
#
DISTRO_NAME = "O-RAN"

# O-RAN distro should not be built for non-x86 archs
#INHERIT += "compatible-archs"

# Set software versions
PREFERRED_VERSION_dpdk = "17%"

# Set preferred providers
PREFERRED_PROVIDER_virtual/monitoring ?= "${@bb.utils.contains('MONITORING_FEATURES', 'zabbix', 'packagegroup-zabbix-monitoring',\
    bb.utils.contains('MONITORING_FEATURES', 'nagios', 'packagegroup-nagios-monitoring', 'packagegroup-empty-monitoring', d),d)}"

PREFERRED_PROVIDER_virtual/libibverbs ?= "libibverbs"

# By default including oran layer will build Nagios core
MONITORING_FEATURES ?= "nagios core"

DISTRO_FEATURES_append = " virtualization kvm"
NON_MULTILIB_RECIPES_append = " ceph"
```

## meta-oran/conf/distro/wrlinux-oran.conf
```bitbake
#@TYPE: Distro
#@NAME: O-RAN
#@DESCRIPTION: O-RAN Distribution

PREFERRED_PROVIDER_virtual/kernel = "linux-yocto-rt"
PREFERRED_VERSION_linux-yocto-rt = "4.18%"

require conf/distro/wrlinux.conf
require conf/distro/wrlinux-ovp.conf

# Note that layer.conf will only add items to BBFILES for
# the wrlinux-oran distro (this one).
#
DISTRO_NAME = "Wind River Linux O-RAN"

# Set software versions
PREFERRED_VERSION_dpdk = "17%"

# Set preferred providers
PREFERRED_PROVIDER_virtual/monitoring ?= "${@bb.utils.contains('MONITORING_FEATURES', 'zabbix', 'packagegroup-zabbix-monitoring',\
    bb.utils.contains('MONITORING_FEATURES', 'nagios', 'packagegroup-nagios-monitoring', 'packagegroup-empty-monitoring', d),d)}"

PREFERRED_PROVIDER_virtual/libibverbs ?= "libibverbs"

# By default including meta-oran layer will build Nagios core
MONITORING_FEATURES ?= "nagios core"

DISTRO_FEATURES_append = " virtualization kvm"
NON_MULTILIB_RECIPES_append = " ceph"
```

## meta-oran/conf/layer.conf
```bitbake
#
# Copyright (C) 2019 Wind River Systems, Inc.
#

# We have a conf and classes directory, add to BBPATH
BBPATH =. "${LAYERDIR}:"

# We have a packages directory, add to BBFILES
BBFILES += " \
    ${LAYERDIR}/recipes-*/*/*.bb \
    ${LAYERDIR}/recipes-*/*/*.bbappend \
    "

BBFILE_COLLECTIONS += "meta-oran"
BBFILE_PATTERN_meta-oran = "^${LAYERDIR}/"
BBFILE_PRIORITY_meta-oran = "7"


LAYERVERSION_meta-oran = "1"

LAYERSERIES_COMPAT_meta-oran = "thud wrl"

LAYER_PATH_meta-oran = "${LAYERDIR}"

LAYERDEPENDS_meta-oran = " \
    core \
    wr-template \
    wrlinux \
    wrlinux-distro \
    wrlinux-ovp \
    virtualization-layer \
    cloud-services-layer \
    realtime \
    dpdk \
    "

LAYERRECOMMENDS_meta-oran = " \
    meta-anaconda \
    "

PNWHITELIST_LAYERS_remove = "meta-oran"

TEMPLATES_PATH = "${LAYER_PATH_meta-oran}/templates"
```

## meta-starlingx/meta-stx-distro/conf/distro/include/stx-features.inc
```bitbake
EXTRA_IMAGE_FEATURES += " empty-root-password"
EXTRA_IMAGE_FEATURES += " allow-empty-password"
EXTRA_IMAGE_FEATURES += " allow-root-login"

#Systemd system
VIRTUAL-RUNTIME_init_manager = "systemd"
DISTRO_FEATURES_NATIVE_append = "systemd"
DISTRO_FEATURES_append = " systemd"
DISTRO_FEATURES_BACKFILL_CONSIDERED_append = "sysvinit"

#Security
# INITRAMFS_IMAGE = "secure-core-image-initramfs"
# DISTRO_FEATURES_append = " selinux"
#DISTRO_FEATURES_NATIVE_append = "ima tpm tpm2 efi-secure-boot luks"
#DISTRO_FEATURES_append += "ima tpm tpm2 efi-secure-boot luks modsign"
#MACHINE_FEATURES_NATIVE_append = "efi"
#MACHINE_FEATURES_append = "efi"
#INITRAMFS_SCRIPTS = "initramfs-live-boot \
#                     initramfs-live-install \
#                    initramfs-live-install-efi \
#                    "

#SECURE_CORE_IMAGE_EXTRA_INSTALL ?= "\
#    packagegroup-efi-secure-boot \
#    packagegroup-tpm \
#    packagegroup-tpm2 \
#    packagegroup-ima \
#    packagegroup-luks \
#    "


# virtualization and cloud stuff
DISTRO_FEATURES_append = " virtualization"
DISTRO_FEATURES_append = " kvm"
DISTRO_FEATURES_append = " openstack"
PREFERRED_PROVIDER_virtual/containerd = "containerd-opencontainers"

# packagegroup-base-zeroconf depends on libnss-mdns which breaks
# the dns resolution for StarlingX
DISTRO_FEATURES_remove = "zeroconf"

#Graphics and misc
#DISTRO_FEATURES_append = " x11 opengl"
#EXTRA_IMAGE_FEATURES_append = " x11-base"
#VIRTUAL-RUNTIME_graphical_init_manager = "lxdm"

PACKAGE_CLASSES = "package_rpm"
DISTRO_FEATURES_append = " bluez pam largefile opengl"

#misc
PREFERRED_PROVIDER_virtual/containerd = "containerd-opencontainers"
PREFERRED_PROVIDER_virtual/kernel ?= "linux-yocto"

VIRTUAL-RUNTIME_syslog = "syslog-ng"
VIRTUAL-RUNTIME_vim = "vim"

DISTRO_FEATURES_append = " selinux"
PREFERRED_PROVIDER_virtual/refpolicy ?= "refpolicy-mls"
```

## meta-starlingx/meta-stx-distro/conf/layer.conf
```bitbake
# We have a conf and classes directory, add to BBPATH
BBPATH .= ":${LAYERDIR}"

# We have recipes-* directories, add to BBFILES
BBFILES += "${LAYERDIR}/recipes-*/*/*.bb \
            ${LAYERDIR}/recipes-*/*/*.bbappend"

BBFILE_COLLECTIONS += "stx-distro-layer"
BBFILE_PATTERN_stx-distro-layer := "^${LAYERDIR}/"
BBFILE_PRIORITY_stx-distro-layer = "5"

LAYERDEPENDS_STX = "\
	core \
	dpdk \
	networking-layer \
	openembedded-layer \
	networking-layer \
	filesystems-layer \
	perl-layer \
	meta-python \
	webserver \
	virtualization-layer \
	cloud-services-layer \
	openstack-layer \
"

LAYERDEPENDS_STX_ANACONDA = "\
	core \
	filesystems-layer \
	meta-python \
	networking-layer \
	openembedded-layer \
"

LAYERDEPENDS_stx-distro-layer = "${@bb.utils.contains('BBFILE_COLLECTIONS', 'meta-anaconda', '${LAYERDEPENDS_STX_ANACONDA}', '${LAYERDEPENDS_STX}', d)}"

# This should only be incremented on significant changes that will
# cause compatibility issues with other layers
LAYERVERSION_stx-distro-version = "1"
LAYERSERIES_COMPAT_stx-distro-layer = "thud warrior"

LAYER_PATH_meta-stx-distro = "${LAYERDIR}"

# Masked recipes:
BBMASK += "/meta-python2/recipes-core/images/meta-python-ptest-image.bb"
BBMASK += "/meta-python2/recipes-core/images/meta-python-image-base.bb"
BBMASK += "/meta-python2/recipes-core/images/meta-python-image.bb"
BBMASK += "/meta-stak-common/recipes-containers/kubernetes/kubernetes_git.bbappend"
BBMASK += "/meta-cloud-services/meta-openstack/recipes-devtools/python/python-cephclient_0.1.0.5.bb"
BBMASK += "/meta-openstack/recipes-devtools/qemu/qemu_2.%.bbappend"
BBMASK += "/meta-cloud-services/meta-openstack/recipes-kernel/linux/linux-yocto_4.18.bbappend"
BBMASK += "/meta-selinux/recipes-graphics/mesa/mesa_%.bbappend"
BBMASK += "/meta-virtualization/recipes-containers/docker-distribution/docker-distribution_git.bb"
BBMASK += "/meta-starlingX/recipes-containers/docker-distribution/docker-distribution_git.bbappend"
BBMASK += "/meta-starlingX/recipes-support/puppet/puppetlabs-stdlib_git.bbappend"
```

## meta-starlingx/meta-stx-flock/conf/layer.conf
```bitbake
# We have a conf and classes directory, add to BBPATH
BBPATH .= ":${LAYERDIR}"

# We have recipes-* directories, add to BBFILES
BBFILES += "${LAYERDIR}/stx-*/*.bb \
            ${LAYERDIR}/stx-*/*.bbappend \
            ${LAYERDIR}/stx-*/*/*.bb \
            ${LAYERDIR}/stx-*/*/*.bbappend"

BBFILE_COLLECTIONS += "stx-flock-layer"
BBFILE_PATTERN_stx-flock-layer := "^${LAYERDIR}/"
BBFILE_PRIORITY_stx-flock-layer = "5"

LAYERDEPENDS_STX_FLOCK = "\
	core \
	dpdk \
	networking-layer \
	openembedded-layer \
	networking-layer \
	filesystems-layer \
	perl-layer \
	meta-python \
	webserver \
	virtualization-layer \
	cloud-services-layer \
	openstack-layer \
"

# This should only be incremented on significant changes that will
# cause compatibility issues with other layers
LAYERVERSION_stx-flock-version = "1"
LAYERSERIES_COMPAT_stx-flock-layer = "thud warrior"

LAYER_PATH_meta-stx-flock = "${LAYERDIR}"

# Masked recipes:
BBMASK += "/meta-python2/recipes-core/images/meta-python-ptest-image.bb"
BBMASK += "/meta-python2/recipes-core/images/meta-python-image-base.bb"
BBMASK += "/meta-python2/recipes-core/images/meta-python-image.bb"
BBMASK += "/meta-stak-common/recipes-containers/kubernetes/kubernetes_git.bbappend"
BBMASK += "/meta-cloud-services/meta-openstack/recipes-devtools/python/python-cephclient_0.1.0.5.bb"
BBMASK += "/meta-openstack/recipes-devtools/qemu/qemu_2.%.bbappend"
BBMASK += "/meta-cloud-services/meta-openstack/recipes-kernel/linux/linux-yocto_4.18.bbappend"
BBMASK += "/meta-selinux/recipes-graphics/mesa/mesa_%.bbappend"
BBMASK += "/meta-virtualization/recipes-containers/docker-distribution/docker-distribution_git.bb"
BBMASK += "/meta-starlingX/recipes-containers/docker-distribution/docker-distribution_git.bbappend"
BBMASK += "/meta-starlingX/recipes-support/puppet/puppetlabs-stdlib_git.bbappend"
```

## meta-starlingx/meta-stx-integ/conf/layer.conf
```bitbake
# We have a conf and classes directory, add to BBPATH
BBPATH .= ":${LAYERDIR}"

# We have recipes-* directories, add to BBFILES
BBFILES += "${LAYERDIR}/recipes-*/*/*.bb \
            ${LAYERDIR}/recipes-*/*/*.bbappend"

BBFILE_COLLECTIONS += "stx-integ-layer"
BBFILE_PATTERN_stx-integ-layer := "^${LAYERDIR}/"
BBFILE_PRIORITY_stx-integ-layer = "5"

LAYERDEPENDS_STX_INTEG = "\
	core \
	dpdk \
	networking-layer \
	openembedded-layer \
	networking-layer \
	filesystems-layer \
	perl-layer \
	meta-python \
	webserver \
	virtualization-layer \
	cloud-services-layer \
	openstack-layer \
"

# This should only be incremented on significant changes that will
# cause compatibility issues with other layers
LAYERVERSION_stx-integ-version = "1"
LAYERSERIES_COMPAT_stx-integ-layer = "thud warrior"

LAYER_PATH_meta-stx-integ = "${LAYERDIR}"

# Masked recipes:
BBMASK += "/meta-python2/recipes-core/images/meta-python-ptest-image.bb"
BBMASK += "/meta-python2/recipes-core/images/meta-python-image-base.bb"
BBMASK += "/meta-python2/recipes-core/images/meta-python-image.bb"
BBMASK += "/meta-stak-common/recipes-containers/kubernetes/kubernetes_git.bbappend"
BBMASK += "/meta-cloud-services/meta-openstack/recipes-devtools/python/python-cephclient_0.1.0.5.bb"
BBMASK += "/meta-openstack/recipes-devtools/qemu/qemu_2.%.bbappend"
BBMASK += "/meta-cloud-services/meta-openstack/recipes-kernel/linux/linux-yocto_4.18.bbappend"
BBMASK += "/meta-selinux/recipes-graphics/mesa/mesa_%.bbappend"
BBMASK += "/meta-virtualization/recipes-containers/docker-distribution/docker-distribution_git.bb"
BBMASK += "/meta-starlingX/recipes-containers/docker-distribution/docker-distribution_git.bbappend"
BBMASK += "/meta-starlingX/recipes-support/puppet/puppetlabs-stdlib_git.bbappend"
BBMASK += "/meta-cloud-services/meta-openstack/recipes-dbs/postgresql/postgresql_%.bbappend"
```

## meta-stx-oran/conf/layer.conf
```bitbake
#
## Copyright (C) 2021 Wind River Systems, Inc.
#
#  Licensed under the Apache License, Version 2.0 (the "License");
#  you may not use this file except in compliance with the License.
#  You may obtain a copy of the License at
#
#      http://www.apache.org/licenses/LICENSE-2.0
#
#  Unless required by applicable law or agreed to in writing, software
#  distributed under the License is distributed on an "AS IS" BASIS,
#  WITHOUT WARRANTIES OR CONDITIONS OF ANY KIND, either express or implied.
#  See the License for the specific language governing permissions and
#  limitations under the License.

# We have a conf and classes directory, add to BBPATH
BBPATH .= ":${LAYERDIR}"

# We have recipes-* directories, add to BBFILES
BBFILES += "${LAYERDIR}/recipes-*/*/*.bb \
            ${LAYERDIR}/recipes-*/*/*.bbappend"

BBFILE_COLLECTIONS += "stx-oran-layer"
BBFILE_PATTERN_stx-oran-layer := "^${LAYERDIR}/"
BBFILE_PRIORITY_stx-oran-layer = "5"

LAYERDEPENDS_STX = "\
	core \
	dpdk \
	networking-layer \
	openembedded-layer \
	networking-layer \
	filesystems-layer \
	perl-layer \
	meta-python \
	webserver \
	virtualization-layer \
	cloud-services-layer \
	openstack-layer \
	stx-distro-layer \
"

LAYERDEPENDS_STX_ANACONDA = "\
	core \
	filesystems-layer \
	meta-python \
	networking-layer \
	openembedded-layer \
	stx-distro-layer \
"

LAYERDEPENDS_stx-oran-layer = "${@bb.utils.contains('BBFILE_COLLECTIONS', 'meta-anaconda', '${LAYERDEPENDS_STX_ANACONDA}', '${LAYERDEPENDS_STX}', d)}"

# This should only be incremented on significant changes that will
# cause compatibility issues with other layers
LAYERVERSION_stx-oran-version = "1"
LAYERSERIES_COMPAT_stx-oran-layer = "thud warrior"

LAYER_PATH_meta-stx-oran = "${LAYERDIR}"
```
