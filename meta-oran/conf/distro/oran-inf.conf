## meta-stx/conf/distro/include/stx-features.inc
```bitbake
#
## Copyright (C) 2019 Wind River Systems, Inc.
#
#  Licensed under the Apache License, Version 2.0 (the "License");
#  you may not use this file except in compliance with the License.
#  You may obtain a copy of the License at
#
#      http://www.apache.org/licenses/LICENSE-2.0
#
#  Unless required by applicable law or agreed to in writing, software
#  distributed under the License is distributed on an "AS IS" BASIS,
#  WITHOUT WARRANTIES OR CONDITIONS OF ANY KIND, either express or implied.
#  See the License for the specific language governing permissions and
#  limitations under the License.

EXTRA_IMAGE_FEATURES += " empty-root-password"
EXTRA_IMAGE_FEATURES += " allow-empty-password"
EXTRA_IMAGE_FEATURES += " allow-root-login"

#Systemd system
VIRTUAL-RUNTIME_init_manager = "systemd"
DISTRO_FEATURES_NATIVE_append = "systemd"
DISTRO_FEATURES_append = " systemd"
DISTRO_FEATURES_BACKFILL_CONSIDERED_append = "sysvinit"

#Security
# INITRAMFS_IMAGE = "secure-core-image-initramfs"
# DISTRO_FEATURES_append = " selinux"
#DISTRO_FEATURES_NATIVE_append = "ima tpm tpm2 efi-secure-boot luks"
#DISTRO_FEATURES_append += "ima tpm tpm2 efi-secure-boot luks modsign"
#MACHINE_FEATURES_NATIVE_append = "efi"
#MACHINE_FEATURES_append = "efi"
#INITRAMFS_SCRIPTS = "initramfs-live-boot \
#                     initramfs-live-install \
#                    initramfs-live-install-efi \
#                    "

#SECURE_CORE_IMAGE_EXTRA_INSTALL ?= "\
#    packagegroup-efi-secure-boot \
#    packagegroup-tpm \
#    packagegroup-tpm2 \
#    packagegroup-ima \
#    packagegroup-luks \
#    "


# virtualization and cloud stuff
DISTRO_FEATURES_append = " virtualization"
DISTRO_FEATURES_append = " kvm"
DISTRO_FEATURES_append = " openstack"
PREFERRED_PROVIDER_virtual/containerd = "containerd-opencontainers"

# packagegroup-base-zeroconf depends on libnss-mdns which breaks
# the dns resolution for StarlingX
DISTRO_FEATURES_remove = "zeroconf"

#Graphics and misc
#DISTRO_FEATURES_append = " x11 opengl"
#EXTRA_IMAGE_FEATURES_append = " x11-base"
#VIRTUAL-RUNTIME_graphical_init_manager = "lxdm"

PACKAGE_CLASSES = "package_rpm"
DISTRO_FEATURES_append = " bluez pam largefile opengl"

#misc
PREFERRED_PROVIDER_virtual/containerd = "containerd-opencontainers"
PREFERRED_PROVIDER_virtual/kernel ?= "linux-yocto"

VIRTUAL-RUNTIME_syslog = "syslog-ng"
VIRTUAL-RUNTIME_vim = "vim"

DISTRO_FEATURES_append = " selinux"
PREFERRED_PROVIDER_virtual/refpolicy ?= "refpolicy-mls"
```

## meta-stx/conf/distro/include/stx-preferred-vers.inc
```bitbake
#
## Copyright (C) 2019 Wind River Systems, Inc.
#
#  Licensed under the Apache License, Version 2.0 (the "License");
#  you may not use this file except in compliance with the License.
#  You may obtain a copy of the License at
#
#      http://www.apache.org/licenses/LICENSE-2.0
#
#  Unless required by applicable law or agreed to in writing, software
#  distributed under the License is distributed on an "AS IS" BASIS,
#  WITHOUT WARRANTIES OR CONDITIONS OF ANY KIND, either express or implied.
#  See the License for the specific language governing permissions and
#  limitations under the License.

PREFERRED_VERSION_ceph = "13.2.2"
PREFERRED_VERSION_dnsmasq = "2.76"
PREFERRED_VERSION_keyutils = "1.6"
PREFERRED_VERSION_python-voluptuous = "0.8.9"
PREFERRED_VERSION_python3-cherrypy = "18.2.0"
PREFERRED_VERSION_python-cheroot = "7.0.0"
PREFERRED_VERSION_python3-cheroot = "7.0.0"
PREFERRED_VERSION_python-cherrypy = "git"
PREFERRED_VERSION_pythonkeystoneauth1 = "3.17.1"
PREFERRED_VERSION_drbd-utils = "8.4.3rc1"
PREFERRED_VERSION_python-pyyaml = "3.13"
PREFERRED_VERSION_python-cmd2 = "0.6.8"
PREFERRED_VERSION_python-expect = "4.6.0"
PREFERRED_VERSION_python-pika = "0.10.0%"
PREFERRED_VERSION_python-keyring = "5.3"
PREFERRED_VERSION_python-barbican = "8.0.%"
PREFERRED_VERSION_python-keystone = "15.0.%"
PREFERRED_VERSION_python-flask = "1.0.2"
PREFERRED_VERSION_python-keystonemiddleware = "5.1.%"
PREFERRED_VERSION_python-oslo.cache= "1.26.%"
PREFERRED_VERSION_python-oslo.concurrency= "3.26.%"
PREFERRED_VERSION_python-oslo.log= "3.38.%"
PREFERRED_VERSION_python-oslo.middleware = "3.31.%"
PREFERRED_VERSION_python-oslo.serialization = "2.23.%"
PREFERRED_VERSION_python-oslo.policy = "1.43.%"
PREFERRED_VERSION_python-pysaml2 = "4.5.%"
PREFERRED_VERSION_python-sqlalchemy = "1.1.17"
PREFERRED_VERSION_python-werkzeug = "0.14.%"
PREFERRED_VERSION_python-neutronclient = "6.12.%"
PREFERRED_VERSION_python-oslo.i18n = "3.20.%"
PREFERRED_VERSION_python-iso8601 = "0.1.12"
PREFERRED_VERSION_python-six = "1.11.%"
PREFERRED_VERSION_python-docker = "3.3.0"
PREFERRED_VERSION_python-pyudev = "0.16.1"
PREFERRED_VERSION_python-django = "1.11.20+%"
PREFERRED_VERSION_python-django-babel = "0.6.2+%"
PREFERRED_VERSION_python-pysnmp = "4.2.5"
PREFERRED_VERSION_python-dateutil = "2.8.1"
PREFERRED_VERSION_python-adal = "1.0.2"
PREFERRED_VERSION_python-osprofiler = "2.3.0+%"
PREFERRED_VERSION_python-amqp = "2.5.2"
PREFERRED_VERSION_python-ryu = "4.24+%"
PREFERRED_VERSION_docker-distribution = "v2.6.2"
PREFERRED_VERSION_kuberenetes = "1.16.%"
PREFERRED_VERSION_ruby = "2.0.0-p648"
PREFERRED_VERSION_ruby-native = "2.0.0-p648"
PREFERRED_VERSION_puppet = "4.8.2"
PREFERRED_VERSION_python-eventlet = "0.18.4"
PREFERRED_VERSION_lldpd = "0.9.0"
```

## meta-stx/conf/distro/poky-stx.conf
```bitbake
#
## Copyright (C) 2019 Wind River Systems, Inc.
#
#  Licensed under the Apache License, Version 2.0 (the "License");
#  you may not use this file except in compliance with the License.
#  You may obtain a copy of the License at
#
#      http://www.apache.org/licenses/LICENSE-2.0
#
#  Unless required by applicable law or agreed to in writing, software
#  distributed under the License is distributed on an "AS IS" BASIS,
#  WITHOUT WARRANTIES OR CONDITIONS OF ANY KIND, either express or implied.
#  See the License for the specific language governing permissions and
#  limitations under the License.

require conf/distro/poky.conf
DISTRO = "poky-stx"
DISTRO_NAME = "Stx (Poky Starlingx Distro)"
DISTRO_VERSION = "2.7.3"
DISTRO_CODENAME = "warrior"

MAINTAINER = "zbsarashki <zbsarashki@gmail.com>"

require conf/distro/include/stx-features.inc
require conf/distro/include/stx-preferred-vers.inc

# For packagegroup-basic
TASK_BASIC_SSHDAEMON = "openssh-sshd openssh-sftp openssh-sftp-server"

# For iso image
#KERNEL_FEATURES += "features/overlayfs/overlayfs.scc"

# Disable services by default
SYSTEMD_AUTO_ENABLE_pn-haproxy = "disable"
SYSTEMD_AUTO_ENABLE_pn-lighttpd = "disable"
SYSTEMD_AUTO_ENABLE_pn-postgresql = "disable"

# networking sysv service is required
SYSTEMD_DISABLED_SYSV_SERVICES_remove = "networking"

# Defines the serial consoles (TTYs) to enable using getty
SERIAL_CONSOLES = "115200;ttyS0"

# /var/log is mounted as a logical volume for stx,
# so do not link to /var/volatile/log.
VOLATILE_LOG_DIR = "no"

# We don't need extra space for iso image
IMAGE_OVERHEAD_FACTOR = "1.05"

# Add extra users and groups for stx
SYSADMIN_P = "4SuW8cnXFyxsk"

EXTRA_USERS_PARAMS_CONFIG = "\
	groupadd -f -g 345 sys_protected; \
	useradd -m -g sys_protected -G root \
	    -d /home/sysadmin -p ${SYSADMIN_P} \
	    -s /bin/sh sysadmin; \
	useradd -p '' haproxy; \
	groupadd haproxy; \
	usermod -a -G haproxy haproxy; \
	useradd -p '' patching; \
	groupadd patching; \
	usermod -a -G patching patching; \
	useradd -p '' nfv; \
	groupadd nfv; \
	usermod -a -G nfv nfv; \
	useradd -p '' www; \
	groupadd www; \
	usermod -a -G www www; \
	usermod -a -G sys_protected sysadmin; \
	usermod -a -G sys_protected sysinv; \
	usermod -a -G sys_protected www; \
	usermod -a -G sys_protected nfv; \
	usermod -a -G sys_protected patching; \
	usermod -a -G sys_protected haproxy; \
	usermod -a -G snmpd fm; \
	usermod -P root root; \
	\
	groupadd -r -g 128 nscd; \
	useradd -M -o -r -d / -s /sbin/nologin -c 'NSCD Daemon' -u 28 -g nscd nscd; \
	"

# Used by:
# neutron-init
# glance-init
CONTROLLER_IP = "127.0.0.1"
HELM_TOOL_KIT_VERSION = "0.1.0"
TIS_PATCH_VER = "7"
HELM_REPO = "stx-platform"
STX_REL = "19.12"

# For the stx /etc/build.info
STX_ID = "3.0"
STX_BUILD_DATE := "${@time.strftime('%Y-%m-%d %H:%M:%S',time.gmtime())}"
```

## meta-stx/conf/layer.conf
```bitbake
#
## Copyright (C) 2019 Wind River Systems, Inc.
#
#  Licensed under the Apache License, Version 2.0 (the "License");
#  you may not use this file except in compliance with the License.
#  You may obtain a copy of the License at
#
#      http://www.apache.org/licenses/LICENSE-2.0
#
#  Unless required by applicable law or agreed to in writing, software
#  distributed under the License is distributed on an "AS IS" BASIS,
#  WITHOUT WARRANTIES OR CONDITIONS OF ANY KIND, either express or implied.
#  See the License for the specific language governing permissions and
#  limitations under the License.

# We have a conf and classes directory, add to BBPATH
BBPATH .= ":${LAYERDIR}"

# We have recipes-* directories, add to BBFILES
BBFILES += "${LAYERDIR}/recipes-*/*/*.bb \
            ${LAYERDIR}/recipes-*/*/*.bbappend"

BBFILE_COLLECTIONS += "stx-layer"
BBFILE_PATTERN_stx-layer := "^${LAYERDIR}/"
BBFILE_PRIORITY_stx-layer = "5"

LAYERDEPENDS_STX = "\
	core \
	dpdk \
	networking-layer \
	openembedded-layer \
	networking-layer \
	filesystems-layer \
	perl-layer \
	meta-python \
	webserver \
	virtualization-layer \
	cloud-services-layer \
	openstack-layer \
"

LAYERDEPENDS_STX_ANACONDA = "\
	core \
	filesystems-layer \
	meta-python \
	networking-layer \
	openembedded-layer \
"

LAYERDEPENDS_stx-layer = "${@bb.utils.contains('BBFILE_COLLECTIONS', 'meta-anaconda', '${LAYERDEPENDS_STX_ANACONDA}', '${LAYERDEPENDS_STX}', d)}"

# This should only be incremented on significant changes that will
# cause compatibility issues with other layers
LAYERVERSION_stx-version = "1"
LAYERSERIES_COMPAT_stx-layer = "thud warrior"

LAYER_PATH_meta-stx = "${LAYERDIR}"

# Masked recipes:
BBMASK += "/meta-python2/recipes-core/images/meta-python-ptest-image.bb"
BBMASK += "/meta-python2/recipes-core/images/meta-python-image-base.bb"
BBMASK += "/meta-python2/recipes-core/images/meta-python-image.bb"
BBMASK += "/meta-stak-common/recipes-containers/kubernetes/kubernetes_git.bbappend"
BBMASK += "/meta-cloud-services/meta-openstack/recipes-devtools/python/python-cephclient_0.1.0.5.bb"
BBMASK += "/meta-openstack/recipes-devtools/qemu/qemu_2.%.bbappend"
BBMASK += "/meta-cloud-services/meta-openstack/recipes-kernel/linux/linux-yocto_4.18.bbappend"
BBMASK += "/meta-selinux/recipes-graphics/mesa/mesa_%.bbappend"
BBMASK += "/meta-virtualization/recipes-containers/docker-distribution/docker-distribution_git.bb"
```
